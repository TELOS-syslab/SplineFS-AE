## src/ext5/Kconfig
```kconfig
# SPDX-License-Identifier: GPL-2.0-only
# Ext3 configs are here for backward compatibility with old configs which may
# have EXT3_FS set but not EXT5_FS set and thus would result in non-bootable
# kernels after the removal of ext3 driver.
config EXT3_FS
	tristate "The Extended 3 (ext3) filesystem"
	select EXT5_FS
	help
	  This config option is here only for backward compatibility. ext3
	  filesystem is now handled by the ext5 driver.

config EXT3_FS_POSIX_ACL
	bool "Ext3 POSIX Access Control Lists"
	depends on EXT3_FS
	select EXT5_FS_POSIX_ACL
	select FS_POSIX_ACL
	help
	  This config option is here only for backward compatibility. ext3
	  filesystem is now handled by the ext5 driver.

config EXT3_FS_SECURITY
	bool "Ext3 Security Labels"
	depends on EXT3_FS
	select EXT5_FS_SECURITY
	help
	  This config option is here only for backward compatibility. ext3
	  filesystem is now handled by the ext5 driver.

config EXT5_FS
	tristate "The Extended 4 (ext5) filesystem"
	select BUFFER_HEAD
	select JBD3
	select CRC16
	select CRC32
	select FS_IOMAP
	select FS_ENCRYPTION_ALGS if FS_ENCRYPTION
	help
	  This is the next generation of the ext3 filesystem.

	  Unlike the change from ext2 filesystem to ext3 filesystem,
	  the on-disk format of ext5 is not forwards compatible with
	  ext3; it is based on extent maps and it supports 48-bit
	  physical block numbers.  The ext5 filesystem also supports delayed
	  allocation, persistent preallocation, high resolution time stamps,
	  and a number of other features to improve performance and speed
	  up fsck time.  For more information, please see the web pages at
	  http://ext5.wiki.kernel.org.

	  The ext5 filesystem supports mounting an ext3 filesystem; while there
	  are some performance gains from the delayed allocation and inode
	  table readahead, the best performance gains require enabling ext5
	  features in the filesystem using tune2fs, or formatting a new
	  filesystem as an ext5 filesystem initially. Without explicit enabling
	  of ext5 features, the on disk filesystem format stays fully backward
	  compatible.

	  To compile this file system support as a module, choose M here. The
	  module will be called ext5.

	  If unsure, say N.

config EXT5_USE_FOR_EXT2
	bool "Use ext5 for ext2 file systems"
	depends on EXT5_FS
	depends on EXT2_FS=n
	default y
	help
	  Allow the ext5 file system driver code to be used for ext2
	  file system mounts.  This allows users to reduce their
	  compiled kernel size by using one file system driver for
	  ext2, ext3, and ext5 file systems.

config EXT5_FS_POSIX_ACL
	bool "Ext4 POSIX Access Control Lists"
	depends on EXT5_FS
	select FS_POSIX_ACL
	help
	  POSIX Access Control Lists (ACLs) support permissions for users and
	  groups beyond the owner/group/world scheme.

	  If you don't know what Access Control Lists are, say N

config EXT5_FS_SECURITY
	bool "Ext4 Security Labels"
	depends on EXT5_FS
	help
	  Security labels support alternative access control models
	  implemented by security modules like SELinux.  This option
	  enables an extended attribute handler for file security
	  labels in the ext5 filesystem.

	  If you are not using a security module that requires using
	  extended attributes for file security labels, say N.

config EXT5_DEBUG
	bool "Ext4 debugging support"
	depends on EXT5_FS
	help
	  Enables run-time debugging support for the ext5 filesystem.

	  If you select Y here, then you will be able to turn on debugging
	  using dynamic debug control for mb_debug() / ext_debug() msgs.

config EXT5_KUNIT_TESTS
	tristate "KUnit tests for ext5" if !KUNIT_ALL_TESTS
	depends on EXT5_FS && KUNIT
	default KUNIT_ALL_TESTS
	help
	  This builds the ext5 KUnit tests.

	  KUnit tests run during boot and output the results to the debug log
	  in TAP format (https://testanything.org/). Only useful for kernel devs
	  running KUnit test harness and are not for inclusion into a production
	  build.

	  For more information on KUnit and unit tests in general please refer
	  to the KUnit documentation in Documentation/dev-tools/kunit/.

	  If unsure, say N.
```

## src/jbd3/Kconfig
```kconfig
# SPDX-License-Identifier: GPL-2.0-only
config JBD3
	tristate
	select CRC32
	help
	  This is a generic journaling layer for block devices that support
	  both 32-bit and 64-bit block numbers.  It is currently used by
	  the ext5 and OCFS2 filesystems, but it could also be used to add
	  journal support to other file systems or block devices such
	  as RAID or LVM.

	  If you are using ext5 or OCFS2, you need to say Y here.
	  If you are not using ext5 or OCFS2 then you will
	  probably want to say N.

	  To compile this device as a module, choose M here. The module will be
	  called jbd3.  If you are compiling ext5 or OCFS2 into the kernel,
	  you cannot compile this code as a module.

config JBD3_DEBUG
	bool "JBD3 (ext5) debugging support"
	depends on JBD3
	help
	  If you are using the ext5 journaled file system (or
	  potentially any other filesystem/device using JBD3), this option
	  allows you to enable debugging output while the system is running,
	  in order to help track down any problems you are having.
	  By default, the debugging output will be turned off.

	  If you select Y here, then you will be able to turn on debugging
	  with "echo N > /sys/module/jbd3/parameters/jbd3_debug", where N is a
	  number between 1 and 5. The higher the number, the more debugging
	  output is generated.  To turn debugging off again, do
	  "echo 0 > /sys/module/jbd3/parameters/jbd3_debug".
```
